## v3/nrf-thingy-91x/nrf_cloud_multi_service/build_provision/Kconfig/boards/Kconfig.thingy91x
```kconfig
# Load board Kconfig descriptions.
osource "/opt/nordic/ncs/v3.0.0/nrf/boards/nordic/thingy91x/Kconfig.thingy91x"
```

## v3/nrf-thingy-91x/nrf_cloud_multi_service/build_provision/b0/Kconfig/Kconfig.shield
```kconfig
osource "/Users/erudy/werl/post-masc/thingy91/nrf_cloud_multi_service/boards/shields/*/Kconfig.shield"
osource "/opt/nordic/ncs/v3.0.0/nrf/boards/shields/*/Kconfig.shield"
```

## v3/nrf-thingy-91x/nrf_cloud_multi_service/build_provision/nrf_cloud_multi_service/Kconfig/Kconfig.shield.defconfig
```kconfig
osource "/Users/erudy/werl/post-masc/thingy91/nrf_cloud_multi_service/boards/shields/*/Kconfig.defconfig"
osource "/opt/nordic/ncs/v3.0.0/nrf/boards/shields/*/Kconfig.defconfig"
```

## v3/nrf-thingy-91x/nrf_cloud_multi_service/build_provision/s1_image/Kconfig/boards/Kconfig.defconfig
```kconfig
# Load Zephyr board defconfig descriptions.
osource "/opt/nordic/ncs/v3.0.0/nrf/boards/nordic/thingy91x/Kconfig.defconfig"
```
